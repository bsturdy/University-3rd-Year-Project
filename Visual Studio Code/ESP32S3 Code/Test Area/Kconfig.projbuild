## Visual Studio Code/ESP32S3 Code/Test Area/Kconfig.projbuild
```kconfig
source "components/WifiClassLib/Kconfig"
source "components/TimerClassLib/Kconfig"
```

## Visual Studio Code/ESP32S3 Code/Test Area/components/TimerClassLib/Kconfig.projbuild
```kconfig
menu "Timer Class Configuration"

    config ESP_CYCLIC_TIMER_GROUP
        int "Select Timer Group For Cyclic Task"
        default 0
        range 0 1
        help
            Choose the timer group for the Cyclic Task. 

                0 = TIMER_GROUP_0

                1 = TIMER_GROUP_1

    config ESP_CYCLIC_TIMER_INDEX
        int "Select Timer Index For Cyclic Task"
        default 0
        range 0 1
        help
            Choose the timer index for the Cyclic Task. The timer group and timer index for the 
            cyclic task cannot be the same as the watchdog task.
                
                0 = TIMER_0

                1 = TIMER_1

    config ESP_WATCHDOG_TIMER_GROUP
        int "Select Timer Group For Watchdog Task"
        default 0
        range 0 1
        help
            Choose the timer group for the Watchdog Task.

                0 = TIMER_GROUP_0

                1 = TIMER_GROUP_1

    config ESP_WATCHDOG_TIMER_INDEX
        int "Select Timer Index For Watchdog Task"
        default 1
        range 0 1
        help
            Choose the timer index for the Watchdog Task. The timer group and timer index for the 
            watchdog task cannot be the same as the cyclic task.
                
                0 = TIMER_0

                1 = TIMER_1

    config ESP_CYCLIC_TASK_PERIOD
        int "Select The Period Of The Cyclic Task In Microseconds (us)"
        default 10000
        range 50 100000000
        help
            Determines how long it takes for the cyclic task to be called.
            
                This value is in Microseconds (us).

    config ESP_WATCHDOG_TASK_PERIOD
        int "Select The Timeout Of The Cyclic Task In Microseconds (us)"
        default 8000
        range 50 100000000
        help
            Set the watchdog timeout period for the cyclic task. This must be less than the cyclic task period.
            
                This value is in Microseconds (us).

    config ESP_TIMER_PRESCALER
        int "Select The Prescaler Used For The Timers"
        default 2
        range 2 65536
        help
            Set the prescalar value used for the timers. This value multiplies the number of clock ticks 
            needed for one timer tick to be recognised.
            
                For example, a clock running at 1000Hz with a prescalar of 5 means that the timer attached
                to that clock will run at 200Hz (5 clock ticks per 1 timer tick).

endmenu
```

## Visual Studio Code/ESP32S3 Code/Test Area/components/WifiClassLib/Kconfig.projbuild
```kconfig
menu "Wifi Class Configuration"

    config ESP_DEVICE_MODE
        int "Wifi Mode"
        range 0 1
        default 0
        help
            Choose the wifi mode for your application.

                0 = Access Point 
            
                1 = Station

    config ESP_WIFI_SSID
        string "WiFi SSID"
        default "Access Point"
        help
            SSID (network name) for the example to connect to

    config ESP_WIFI_PASSWORD
        string "WiFi Password"
        default "12345678"
        help
            WiFi password (WPA or WPA2) for the example to use

    config ESP_WIFI_CHANNEL
        int "WiFi Channel"
        range 1 13
        default 6
        help
            WiFi channel (network channel) for the example to use

    config ESP_MAX_STA_CONN
        int "Maximal STA connections"
        range 1 25
        default 4
        help
            Max number of the STA connects to AP

    config ESP_UDP_PORT
        int "UDP Port"
        range 1 65535
        default 25000
        help
            The port that UDP uses

    config ESP_SYNC_SYSTEM
        int "Wifi Sync System"
        range 0 1
        default 1
        help
            Enable or Disable the sync system that manages the wifi disconenctions quickly

                0 = Disable
            
                1 = Enable

endmenu
```

## Visual Studio Code/Implementation 1/main/Kconfig.projbuild
```kconfig
menu "Device Configuration"

config ESP_NODE_UID
    hex "Node unique ID (64-bit hex)"
    default 0x0000000000000001
    help
        64-bit unique ID for this node.
        Enter as 16 hex digits, e.g. 0x1122334455667788.

endmenu
```
